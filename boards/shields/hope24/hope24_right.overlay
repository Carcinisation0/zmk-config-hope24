#include "hope24.dtsi" // The shared dtsi file is included in the overlay

&default_transform { // Offset of 4 because the left side has 4 columns
    col-offset = <4>;
};

// Label of the kscan node in the dtsi
&kscan0 {
    col-gpios
        = <&pro_micro 21 GPIO_ACTIVE_HIGH>
        , <&pro_micro 20 GPIO_ACTIVE_HIGH>
        , <&pro_micro 19 GPIO_ACTIVE_HIGH>
        , <&pro_micro 18 GPIO_ACTIVE_HIGH>
        ;
};

