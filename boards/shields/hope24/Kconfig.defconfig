## boards/shields/hope24/Kconfig.defconfig
```kconfig
if SHIELD_HOPE24_LEFT

# Name must be less than 16 characters long!
config ZMK_HOPE24
    default "hope24"

config ZMK_SPLIT_ROLE_CENTRAL
    default y

endif

if SHIELD_HOPE24_LEFT || SHIELD_HOPE24_RIGHT

config ZMK_SPLIT
    default y

endif
```

## boards/shields/hope24/Kconfig.shield
```kconfig
config SHIELD_HOPE24_LEFT
    def_bool $(shields_list_contains,hope24_left)


config SHIELD_HOPE24_RIGHT
    def_bool $(shields_list_contains,hope24_right)
```

## config/west.yml
```yaml
manifest:
  remotes:
    - name: zmkfirmware
      url-base: https://github.com/zmkfirmware
    - name: urobix
      url-base: https://github.com/urob
  projects:
    - name: zmk
      remote: zmkfirmware
      revision: main
      import: app/west.yml
    - name: zmk-nodefree-config
      remote: urobix
      revision: main
  self:
    path: config
```
